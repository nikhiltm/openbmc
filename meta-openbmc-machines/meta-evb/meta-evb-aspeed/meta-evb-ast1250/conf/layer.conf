## meta-openbmc-machines/meta-evb/meta-evb-aspeed/meta-evb-ast1250/conf/layer.conf
```bitbake
# We have a conf and classes directory, add to BBPATH
BBPATH .= ":${LAYERDIR}"

BBFILE_COLLECTIONS += "evb-ast1250"
BBFILE_PATTERN_evb-ast1250 = ""
```

## meta-openbmc-machines/meta-evb/meta-evb-aspeed/meta-evb-ast1250/conf/machine/evb-ast1250.conf
```bitbake
KMACHINE = "aspeed"
#KERNEL_DEVICETREE = "${KMACHINE}-ast1250-evb.dtb"

#UBOOT_MACHINE = "ast_g5_phy_config"

FLASH_SIZE = "32768"

require conf/machine/include/ast1250.inc
require conf/machine/include/obmc-bsp-common.inc
```

## meta-openbmc-machines/meta-evb/meta-evb-aspeed/meta-evb-ast2400/conf/layer.conf
```bitbake
# We have a conf and classes directory, add to BBPATH
BBPATH .= ":${LAYERDIR}"

BBFILE_COLLECTIONS += "evb-ast2400"
BBFILE_PATTERN_evb-ast2400 = ""
```

## meta-openbmc-machines/meta-evb/meta-evb-aspeed/meta-evb-ast2400/conf/machine/evb-ast2400.conf
```bitbake
KMACHINE = "aspeed"
KERNEL_DEVICETREE = "${KMACHINE}-ast2500-evb.dtb"

UBOOT_MACHINE = "ast_g4_phy_config"

FLASH_SIZE = "32768"

require conf/machine/include/ast2400.inc
require conf/machine/include/obmc-bsp-common.inc
```
